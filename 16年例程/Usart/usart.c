/********************************************************************************************************
串口函数
********************************************************************************************************/
#include "usart.h"

u8 receive_now;//表示是否处于一个正在接收数据包的状态
u8 num_now;      //计数
u8 receive_flag = 0;//是否接收到一个完整的数据包标志
u8 rec;             //数据中间变量
u8 buf[N];          //中断接收到的数据

#pragma interrupt_handler uart0_rx_isr:iv_USART0_RXC
/********************************************************************************************************
Description  : 串口接收中断
Inputs       : 中断
Outputs      : 改变buf
********************************************************************************************************/
void uart0_rx_isr(void)
{

    rec = UDR ;
    if(rec == '*')                          //检测是否是包头
    {
        receive_now = 1;
        num_now   = 0 ;
        receive_flag = 0;
        return ;
    }
    if(rec == '\n')                          //检测是否是包尾
    {
        receive_now = 0;
        receive_flag = 1;                      //用于告知系统已经接收到一个完整的数据包
        return ;
    }
    if(receive_now ==1)                          //是否处于接收数据包状态
    {
        buf[num_now++] = rec;
    }
}
/********************************************************************************************************
Description  : 串口初始化
Inputs       : baud：波特率   4800->25  9600->12(选择倍速模式)
Outputs      : None
********************************************************************************************************/
void USART_Init(u16 baud)
{
    //端口初始化 PD0->Rx  PD1->Tx
    UCSRB &= ~ (USART_UCSZ2);
    UCSRC |= (UCSRC_URSEL | USART_UCSZ1 | USART_UCSZ0);        //8位字符长度
    UCSRC &= ~(USART_UMSEL | USART_UPM | USART_USBS);          //异步工作模式,无奇偶校验位,1位停止位


    //波特率配置
    UCSRA |= USART_U2X;                 //倍速发送
    UBRRH &= ~ (UBRRH_URSEL);              //对UBRRH进行写操作
    UBRRH = (u8)(baud >> 8);
    UBRRL = (u8)baud;

    UCSRB |= (USART_RXCIE | USART_RXEN | USART_TXEN);  //发送、接收 中断 使能
}
/********************************************************************************************************
Description  : 串口接收
Inputs       : None
Outputs      : 接收到的数
********************************************************************************************************/
u8 USART_Rx(void)
{
    u8 buf;
    while((UCSRA&USART_FLAG_RXC) == 0);           //等待接收结束       while((UCSRA&USART_FLAG_RXC) == 0)
    buf = UDR;                           //读取接收到的值
    return buf;
}
/********************************************************************************************************
Description  : 串口发送
Inputs       : 要发送的数据
Outputs      : None
********************************************************************************************************/
void USART_Tx(u8 buf)
{
    UCSRA |= USART_FLAG_UDRE;             //缓冲器为空，准备好发送数据
    UDR = buf;                            //将数据写入发送寄存器
    while((USART_FLAG_TXC) == 0);          //等待发送完成       while((UCSRA&USART_FLAG_TXC) == 0)
}
/********************************************************************************************************
Description  :串口发送字符串
Inputs       :字符串
Outputs      : None
********************************************************************************************************/
void USART_send(u8 *s)
{
    while(*s != '\0')
    {
        USART_Tx(*s);
        s++;
        Delay_us(200);
    }
    USART_Tx('\n');
    Delay_us(200);

}
